## boards/shields/leighboard26/Kconfig.defconfig
```kconfig
if SHIELD_LEIGHBOARD26_DONGLE

# Name must be less than 16 characters long!
config ZMK_KEYBOARD_NAME
    default "leighboard26"

config ZMK_SPLIT
    default y

config ZMK_SPLIT_ROLE_CENTRAL
    default y

config ZMK_SPLIT_BLE_CENTRAL_PERIPHERALS
  default 2

config BT_MAX_CONN
  default 6

config BT_MAX_PAIRED
  default 6

config ZMK_SPLIT_BLE_CENTRAL_BATTERY_LEVEL_FETCHING
  default n

endif

if SHIELD_LEIGHBOARD26_LEFT

# Name must be less than 16 characters long!
config ZMK_KEYBOARD_NAME
    default "leighboard26"

config ZMK_SPLIT_ROLE_CENTRAL
    default n

config ZMK_SPLIT
    default y
    
endif

if SHIELD_LEIGHBOARD26_LEFT || SHIELD_LEIGHBOARD26_RIGHT

config ZMK_SPLIT_ROLE_CENTRAL
    default n

config ZMK_SPLIT
    default y

endif
```

## boards/shields/leighboard26/Kconfig.shield
```kconfig
config SHIELD_LEIGHBOARD26_LEFT
    def_bool $(shields_list_contains,leighboard26_left)

config SHIELD_LEIGHBOARD26_RIGHT
    def_bool $(shields_list_contains,leighboard26_right)

config SHIELD_LEIGHBOARD26_DONGLE
    def_bool $(shields_list_contains,leighboard26_dongle)
```

## config/west.yml
```yaml
manifest:
  defaults:
    revision: v0.3
  remotes:
    - name: zmkfirmware
      url-base: https://github.com/zmkfirmware
    - name: maurzo
      url-base: https://github.com/maurzo
  projects:
    - name: zmk
      remote: zmkfirmware
      import: app/west.yml
    - name: zmk-behavior-battery-percentage-printer
      remote: maurzo
      revision: main
  self:
    path: config
```

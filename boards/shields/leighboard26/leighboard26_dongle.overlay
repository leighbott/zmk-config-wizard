#include "leighboard26.dtsi"

/ {
    kscan_dongle: kscan_dongle {
        compatible = "zmk,kscan-mock";
        columns = <0>;
        rows = <0>;
        events = <0>;
    };
};

&physical_layout_leighboard26 {
    kscan = <&kscan_dongle>;
};

